/*
 * Copyright (c) 2022 The ZMK Contributors
 *
 * SPDX-License-Identifier: MIT
 */

&lpm_view_spi {
    status = "okay";
    lpm_view: lcd@0 {
        compatible = "jdi,lpm009m360a";
        spi-max-frequency = <4000000>;
        reg = <0>;
				width = <144>;
				height = <72>;
				color_mode = [02];
				reverse = <1>; 
				rotation = <1>;
    };
};

/ {
    chosen {
        zephyr,display = &lpm_view;
    };
};
