/*
 * Copyright (c) 2022 The ZMK Contributors
 *
 * SPDX-License-Identifier: MIT
 */

&nice_view_spi {
    status = "okay";
    nice_view: lcd@0 {
        compatible = "jdi,lpm009m360a";
        spi-max-frequency = <4000000>;
        reg = <0>;
				disp_gpios = <&gpio0 16 GPIO_ACTIVE_HIGH>;
				extcomin_gpios = <&gpio0 23 GPIO_ACTIVE_HIGH>;
				width = <144>;
				height = <72>;
				color_mode = [02];
				reverse = <0>;
				rotation = <0>;
    };
};

/ {
    chosen {
        zephyr,display = &nice_view;
    };
};
