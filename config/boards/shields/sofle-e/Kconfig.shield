## config/boards/shields/sofle-e/Kconfig.shield
```kconfig
# Copyright (c) 2020 Ryan Cross
# SPDX-License-Identifier: MIT

config SHIELD_SOFLE_E_LEFT
    def_bool $(shields_list_contains,sofle-e_left)

config SHIELD_SOFLE_E_RIGHT
    def_bool $(shields_list_contains,sofle-e_right)
```

## config/boards/shields/sofle-plus/Kconfig.shield
```kconfig
# Copyright (c) 2020 Ryan Cross
# SPDX-License-Identifier: MIT

config SHIELD_SOFLE_PLUS_LEFT
    def_bool $(shields_list_contains,sofle-plus_left)

config SHIELD_SOFLE_PLUS_RIGHT
    def_bool $(shields_list_contains,sofle-plus_right)
```
