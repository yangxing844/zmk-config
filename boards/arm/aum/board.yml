## boards/arm/aum/board.yml
```yaml
boards:
  - name: aum_left
    vendor: modifier_key
    socs:
      - name: nrf52840
  - name: aum_right
    vendor: modifier_key
    socs:
      - name: nrf52840
```

## boards/arm/corne-v4/Kconfig.corne-v4_left
```kconfig
# SPDX-License-Identifier: MIT

config BOARD_CORNE_V4_LEFT
    select SOC_NRF52840_QIAA
    select BOARD_CORNE_LEFT
    select ZMK_BOARD_COMPAT
    imply RETAINED_MEM
    imply RETENTION
    imply RETENTION_BOOT_MODE
```

## boards/arm/corne-v4/Kconfig.corne-v4_right
```kconfig
# SPDX-License-Identifier: MIT

config BOARD_CORNE_V4_RIGHT
    select SOC_NRF52840_QIAA
    select BOARD_CORNE_RIGHT
    select ZMK_BOARD_COMPAT
    imply RETAINED_MEM
    imply RETENTION
    imply RETENTION_BOOT_MODE
```

## boards/arm/dongle833/Kconfig
```kconfig
# SPDX-License-Identifier: MIT

config BOARD_ENABLE_DCDC
    bool "Enable DCDC mode"
    default n
    depends on BOARD_DONGLE_833
```

## boards/arm/dongle833/Kconfig.defconfig
```kconfig
# SPDX-License-Identifier: MIT

if BOARD_DONGLE_833

if USB

config USB_DEVICE_STACK
    default y

endif # USB

endif # BOARD_DONGLE_833
```

## boards/arm/dongle833/Kconfig.dongle_833
```kconfig
# SPDX-License-Identifier: MIT

config BOARD_DONGLE_833
    select SOC_NRF52833_QIAA
    select ZMK_BOARD_COMPAT
    imply RETAINED_MEM
    imply RETENTION
    imply RETENTION_BOOT_MODE
```

## boards/arm/e73/Kconfig
```kconfig
# SPDX-License-Identifier: MIT

config BOARD_ENABLE_DCDC
    bool "Enable DCDC mode"
    default y
    depends on BOARD_E73
```

## boards/arm/e73/Kconfig.defconfig
```kconfig
# SPDX-License-Identifier: MIT

if BOARD_E73

if USB

config USB_DEVICE_STACK
    default y

endif # USB

config I2C
    default y

endif # BOARD_E73
```

## boards/arm/mikoto/Kconfig.defconfig
```kconfig
# SPDX-License-Identifier: MIT

if BOARD_MIKOTO

if USB

config USB_DEVICE_STACK
    default y

endif # USB

config I2C
    default y

config ZMK_MAX17048
    default y

endif # BOARD_MIKOTO
```

## boards/arm/polaris/Kconfig.polaris_right
```kconfig
# SPDX-License-Identifier: MIT

config BOARD_POLARIS_RIGHT
    select SOC_NRF52840_QIAA
    select ZMK_BOARD_COMPAT
    imply RETAINED_MEM
    imply RETENTION
    imply RETENTION_BOOT_MODE
```

## boards/arm/polaris/polaris_left_defconfig
```kconfig
# SPDX-License-Identifier: MIT

CONFIG_ZMK_EXT_POWER=y
CONFIG_ZMK_STUDIO_LOCKING=n
CONFIG_ZMK_STUDIO=y
CONFIG_USB_DEVICE_STACK=y
CONFIG_USB_CDC_ACM=y
CONFIG_SERIAL=y
CONFIG_UART_INTERRUPT_DRIVEN=y
CONFIG_UART_LINE_CTRL=y

CONFIG_INPUT=y
CONFIG_I2C=y
CONFIG_ZMK_POINTING=y
# CONFIG_INPUT_AZOTEQ_IQS5XX=y
CONFIG_ZMK_POINTING_SMOOTH_SCROLLING=y
CONFIG_SPI=y
# Enable MPU
CONFIG_ARM_MPU=y

CONFIG_PINCTRL=y
CONFIG_GPIO=y

CONFIG_USE_DT_CODE_PARTITION=y
CONFIG_BUILD_OUTPUT_UF2=y

CONFIG_MPU_ALLOW_FLASH_WRITE=y
CONFIG_NVS=y
CONFIG_SETTINGS_NVS=y
CONFIG_FLASH=y
CONFIG_FLASH_PAGE_LAYOUT=y
CONFIG_FLASH_MAP=y

CONFIG_ZMK_USB=y
CONFIG_ZMK_BLE=y

CONFIG_BOARD_CHARGER_CURRENT_100MA=y

CONFIG_EC11=y
CONFIG_EC11_TRIGGER_GLOBAL_THREAD=y
```

## boards/modkey/planck/Kconfig.defconfig
```kconfig
# Copyright (c) 2020 The ZMK Contributors
# SPDX-License-Identifier: MIT

if BOARD_PLANCK_LEFT

config ZMK_KEYBOARD_NAME
    default "PlanckBoy"

config ZMK_SPLIT_ROLE_CENTRAL
    default y

endif # BOARD_PLANCK_LEFT

if BOARD_PLANCK_LEFT || BOARD_PLANCK_RIGHT

config ZMK_SPLIT
    default y

if USB

config USB_DEVICE_STACK
    default y

endif # USB

if LVGL

config ZMK_DISPLAY_DEDICATED_THREAD_STACK_SIZE
    default 8192

config LV_Z_VDB_SIZE
    default 64

config LV_DPI_DEF
    default 148

config LV_Z_BITS_PER_PIXEL
    default 1

choice LV_COLOR_DEPTH
    default LV_COLOR_DEPTH_1
endchoice

endif # LVGL

choice BOARD_CHARGER_CURRENT
    default BOARD_CHARGER_CURRENT_100MA
endchoice

config I2C
    default y

config SPI
    default y

endif # BOARD_PLANCK_LEFT || BOARD_PLANCK_RIGHT
```

## config/boards/arm/corne-v4/Kconfig.corne-v4_right
```kconfig
# SPDX-License-Identifier: MIT

config BOARD_CORNE_V4_RIGHT
    select SOC_NRF52840_QIAA
    select BOARD_CORNE_RIGHT
    imply RETAINED_MEM
    imply RETENTION
    imply RETENTION_BOOT_MODE
```

## config/boards/arm/corne-v4/board.yml
```yaml
boards:
  - name: corne-v4_left
    vendor: modifier_key
    socs:
      - name: nrf52840
  - name: corne-v4_right
    vendor: modifier_key
    socs:
      - name: nrf52840
```

## config/boards/arm/dongle833/Kconfig.dongle_833
```kconfig
# SPDX-License-Identifier: MIT

config BOARD_DONGLE_833
    select SOC_NRF52833_QIAA
    imply RETAINED_MEM
    imply RETENTION
    imply RETENTION_BOOT_MODE
```

## config/boards/arm/e73/Kconfig.e73
```kconfig
# SPDX-License-Identifier: MIT

config BOARD_E73
    select SOC_NRF52840_QIAA
    imply RETAINED_MEM
    imply RETENTION
    imply RETENTION_BOOT_MODE
```

## config/west.yml
```yaml
manifest:
  remotes:
    - name: zmk
      url-base: https://github.com/zmkfirmware
    - name: cormoran
      url-base: https://github.com/cormoran
    - name: badjeff
      url-base: https://github.com/badjeff
    - name: yangxing
      url-base: https://github.com/yangxing844
  projects:
    - name: zmk
      remote: cormoran
      revision: main+dya
      import: app/west.yml
    - name: zmk-pmw3610-driver
      remote: badjeff
      revision: main
    - name: zmk-lpm009m360a-driver
      remote: yangxing
      revision: master
    - name: zmk-driver-pmw3610-with-custom-studio-rpc
      remote: cormoran
      revision: main
    - name: zmk-module-runtime-input-processor
      remote: cormoran
      revision: main
    - name: zmk-module-ble-management
      remote: cormoran
      revision: main
    - name: zmk-module-settings-rpc
      remote: cormoran
      revision: main
    - name: zmk-module-battery-history
      remote: cormoran
      revision: main
    - name: zmk-feature-custom-settings
      remote: cormoran
      revision: main
    - name: zmk-feature-os-detection
      remote: cormoran
      revision: main
    - name: zmk-feature-default-layer
      remote: cormoran
      revision: codex/custom-rpc-rewrite
    - name: zmk-feature-module-physical-layout
      remote: cormoran
      revision: main
    - name: zmk-feature-device-info
      remote: cormoran
      revision: main
    - name: zmk-feature-watchdog
      remote: cormoran
      revision: main
    - name: zmk-feature-runtime-macro
      remote: cormoran
      revision: main
    - name: zmk-feature-runtime-combo
      remote: cormoran
      revision: main
  self:
    path: config
```
