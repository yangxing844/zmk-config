/*
 * Copyright (c) 2020 ZMK Contributors
 *
 * SPDX-License-Identifier: MIT
 */

#include "charybdis.dtsi"
#include <input/processors.dtsi>
#include <dt-bindings/zmk/input_transform.h>

&pmw_listener {
    status = "okay";

    scroller {
        layers = <3>;
        input-processors = <&zip_xy_transform (INPUT_TRANSFORM_Y_INVERT) &zip_xy_scaler 1 10 &zip_xy_to_scroll_mapper>;
    };

    snipe {
        layers = <4>;
        input-processors = <&zip_xy_scaler 1 3>;
    };

    input-processors = <&zip_temp_layer 2 1000>;
};
