## boards/modkey/planck/board.yml
```yaml
boards:
  - name: planck_left
    vendor: modifier_key
    socs:
      - name: nrf52840
  - name: planck_right
    vendor: modifier_key
    socs:
      - name: nrf52840
```

## boards/shields/lpm_view/Kconfig.shield
```kconfig
# Copyright (c) 2022 The ZMK Contributors
# SPDX-License-Identifier: MIT

config SHIELD_LPM_VIEW
    def_bool $(shields_list_contains,lpm_view)
```

## boards/shields/nice_view_gem/Kconfig.defconfig
```kconfig
if SHIELD_NICE_VIEW_GEM

config LV_Z_VDB_SIZE
    default 100

config LV_DPI_DEF
    default 161

config LV_Z_BITS_PER_PIXEL
    default 1

choice LV_COLOR_DEPTH
    default LV_COLOR_DEPTH_1
endchoice

choice ZMK_DISPLAY_WORK_QUEUE
    default ZMK_DISPLAY_WORK_QUEUE_DEDICATED
endchoice

choice ZMK_DISPLAY_STATUS_SCREEN
    default ZMK_DISPLAY_STATUS_SCREEN_CUSTOM
endchoice

config LV_Z_MEM_POOL_SIZE
    default 8196 if ZMK_DISPLAY_STATUS_SCREEN_CUSTOM

config ZMK_DISPLAY_STATUS_SCREEN_CUSTOM
    imply NICE_VIEW_WIDGET_STATUS

config NICE_VIEW_WIDGET_STATUS
    select LV_USE_LABEL
    select LV_USE_IMAGE
    select LV_USE_CANVAS
    select LV_USE_ANIMIMG
    select LV_USE_ANIMATION

config NICE_VIEW_WIDGET_INVERTED
    bool "Invert display colors"

if !ZMK_SPLIT || ZMK_SPLIT_ROLE_CENTRAL

config NICE_VIEW_WIDGET_STATUS
    select ZMK_WPM

endif # !ZMK_SPLIT || ZMK_SPLIT_ROLE_CENTRAL

endif # SHIELD_NICE_VIEW_GEM
```

## boards/shields/sofle-x/Kconfig.shield
```kconfig
# Copyright (c) 2020 Ryan Cross
# SPDX-License-Identifier: MIT

config SHIELD_SOFLE_X_LEFT
    def_bool $(shields_list_contains,sofle-x_left)

config SHIELD_SOFLE_X_RIGHT
    def_bool $(shields_list_contains,sofle-x_right)
```

## config/boards/arm/aum/Kconfig
```kconfig
#
# Copyright (c) 2022 The ZMK Contributors
# SPDX-License-Identifier: MIT
#

config BOARD_AUM_LEFT
    bool
config BOARD_AUM_RIGHT
    bool 


config BOARD_ENABLE_DCDC
    bool "Enable DCDC mode"
    select SOC_DCDC_NRF52X
    default y


choice BOARD_CHARGER_CURRENT
    prompt "Charge current to supply to attached batteries"


config BOARD_CHARGER_CURRENT_40MA
    bool "40mA charge current, for battery capacity 40mAh or higher"

config BOARD_CHARGER_CURRENT_100MA
    bool "100mA charge current, for battery capacity 100mAh or higher"

config BOARD_CHARGER_CURRENT_150MA
    bool "150mA charge current, for battery capacity 150mAh or higher"

config BOARD_CHARGER_CURRENT_250MA
    bool "250mA charge current, for battery capacity 250mAh or higher"

config BOARD_CHARGER_CURRENT_350MA
    bool "350mA charge current, for battery capacity 350mAh or higher"

config BOARD_CHARGER_CURRENT_NONE
    bool "Disable charge current"

endchoice
```

## config/boards/arm/aum/Kconfig.board
```kconfig
#
#
# copyright (c) 2020 YangXing
# SPDX-License-Identifier: MIT

config BOARD_AUM_V1_LEFT
		bool "AUM wireless left"
		depends on SOC_NRF52840_QIAA
		select BOARD_AUM_LEFT

config BOARD_AUM_V1_RIGHT
		bool "AUM wireless right"
		depends on SOC_NRF52840_QIAA
		select BOARD_AUM_RIGHT
```

## config/boards/arm/corne-v4/Kconfig.board
```kconfig
# corne-v4 wireless board configuration
#
#
# copyright (c) 2020 YangXing
# SPDX-License-Identifier: MIT

config BOARD_CORNE_V4_LEFT
		bool "Corne-v4 wireless left"
		depends on SOC_NRF52840_QIAA
		select BOARD_CORNE_LEFT

config BOARD_CORNE_V4_RIGHT
		bool "Corne-v4 wireless right"
		depends on SOC_NRF52840_QIAA
		select BOARD_CORNE_RIGHT
```

## config/boards/arm/corne-v4/Kconfig.defconfig
```kconfig
if BOARD_CORNE_LEFT

config ZMK_KEYBOARD_NAME
		default "Corne V4"

config ZMK_SPLIT_ROLE_CENTRAL
		default y

endif # BOARD_CORNE_LEFT

if BOARD_CORNE_LEFT || BOARD_CORNE_RIGHT

config BOARD
		default "corne v4"

config ZMK_SPLIT
		default y

config BT_CTLR
		default BT

if USB

config USB_NRFX
    default y

config USB_DEVICE_STACK
    default y

endif # USB

if ZMK_DISPLAY
config SPI
    default y
config SSD1306
    default n
endif # ZMK_DISPLAY


if LVGL
config ZMK_DISPLAY_DEDICATED_THREAD_STACK_SIZE
	default 8192

#config LV_HOR_RES_MAX
	#default 128
#config LV_VER_RES_MAX
	#default 32
config LV_Z_VDB_SIZE
	default 64

config LV_DPI_DEF
	default 148
config LV_Z_BITS_PER_PIXEL
	default 1
choice LV_COLOR_DEPTH
	default LV_COLOR_DEPTH_1
endchoice

endif # LVGL

# config ZMK_WIDGET_WPM_STATUS
# 	default y
choice BOARD_CHARGER_CURRENT
    default BOARD_CHARGER_CURRENT_100MA
endchoice

config I2C
	default y
config SPI
	default y

endif 
```

## config/boards/arm/dongle833/Kconfig
```kconfig
config BOARD_ENABLE_DCDC
    bool "Enable DCDC mode"
    select SOC_DCDC_NRF52X
    default n
    depends on BOARD_DONGLE_833
```

## config/boards/arm/dongle833/Kconfig.board
```kconfig
# mikoto board configuration

# Copyright (c) 2020 The ZMK Contributors
# SPDX-License-Identifier: MIT

config BOARD_DONGLE_833
    bool "dongle 833"
    depends on SOC_NRF52833_QIAA
```

## config/boards/arm/dongle833/Kconfig.defconfig
```kconfig
# Electronut Labs Papyr board configuration

# Copyright (c) 2020 The ZMK Contributors
# SPDX-License-Identifier: MIT

if BOARD_DONGLE_833

config BOARD
    default "dongle 833"


if USB_DEVICE_STACK 

config USB_NRFX
    default y


endif 
config BT_CTLR
    default BT
endif 
```

## config/boards/arm/e73/Kconfig.board
```kconfig
# mikoto board configuration

# Copyright (c) 2020 The ZMK Contributors
# SPDX-License-Identifier: MIT

config BOARD_E73
    bool "e73 board"
    depends on SOC_NRF52840_QIAA
```

## config/boards/arm/e73/Kconfig.defconfig
```kconfig
# Electronut Labs Papyr board configuration

# Copyright (c) 2020 The ZMK Contributors
# SPDX-License-Identifier: MIT

if BOARD_E73

config BOARD
    default "Ebyre E73"

if USB

config USB_NRFX
    default y

config USB_DEVICE_STACK
    default y

endif # USB

config BT_CTLR
    default BT

config I2C
		default y

endif 
```

## config/boards/arm/mikoto/Kconfig.defconfig
```kconfig
# Electronut Labs Papyr board configuration

# Copyright (c) 2020 The ZMK Contributors
# SPDX-License-Identifier: MIT

if BOARD_MIKOTO

config BOARD
    default "mikoto"

if USB

config USB_NRFX
    default y

config USB_DEVICE_STACK
    default y

endif # USB

config BT_CTLR
    default BT

config I2C
		default y
config ZMK_MAX17048
		default y

endif # BOARD_MIKOTO
```

## config/boards/arm/planck/Kconfig.board
```kconfig
# mikoto board configuration

# Copyright (c) 2020 The ZMK Contributors
# SPDX-License-Identifier: MIT

config BOARD_PLANCK_LEFT
    bool "PLANCK ortholiner 3x6 board"
    depends on SOC_NRF52840_QIAA



config BOARD_PLANCK_RIGHT
    bool "PLANCK ortholiner 3x6 board"
    depends on SOC_NRF52840_QIAA
```

## config/boards/arm/planck/planck_left_defconfig
```kconfig
# SPDX-License-Identifier: MIT

CONFIG_ZMK_EXT_POWER=y
CONFIG_SOC_SERIES_NRF52X=y
CONFIG_SOC_NRF52840_QIAA=y
CONFIG_BOARD_PLANCK_LEFT=y

CONFIG_LOG_PROCESS_THREAD_STARTUP_DELAY_MS=4000
CONFIG_ZMK_DISPLAY=y
CONFIG_SPI=y
# Enable MPU
CONFIG_ARM_MPU=y

CONFIG_PINCTRL=y

CONFIG_ZMK_RGB_UNDERGLOW=y
# Use the STRIP config specific to the LEDs you're using
CONFIG_WS2812_STRIP=y

CONFIG_GPIO=y

CONFIG_USE_DT_CODE_PARTITION=y
CONFIG_BUILD_OUTPUT_UF2=y

CONFIG_MPU_ALLOW_FLASH_WRITE=y
CONFIG_NVS=y
CONFIG_SETTINGS_NVS=y
CONFIG_FLASH=y
CONFIG_FLASH_PAGE_LAYOUT=y
CONFIG_FLASH_MAP=y

CONFIG_ZMK_USB=y
CONFIG_ZMK_BLE=y


CONFIG_BOARD_CHARGER_CURRENT_100MA=y

CONFIG_EC11=y
CONFIG_EC11_TRIGGER_GLOBAL_THREAD=y
```

## config/boards/arm/polaris/Kconfig.board
```kconfig
# mikoto board configuration

# Copyright (c) 2020 The ZMK Contributors
# SPDX-License-Identifier: MIT

config BOARD_POLARIS_LEFT
    bool "POLARIS ortholiner 3x6 board"
    depends on SOC_NRF52840_QIAA



config BOARD_POLARIS_RIGHT
    bool "POLARIS ortholiner 3x6 board"
    depends on SOC_NRF52840_QIAA
```

## config/boards/arm/polaris/Kconfig.polaris_left
```kconfig
config BOARD_POLARIS_LEFT
		select SOC_NRF52840_QIAA
		imply RETAINED_MEM
		imply RETENTION
		imply RETENTION_BOOT_MODE
```

## config/boards/arm/polaris/board.yml
```yaml
boards:
  - name: polaris_left
    vendor: modifier_key
    socs:
      - name: nrf52840
  - name: polaris_right
    vendor: modifier_key
    socs:
      - name: nrf52840
```

## config/boards/shields/charybdis_dongle/Kconfig.defconfig
```kconfig
if SHIELD_CHARYBDIS_DONGLE

config ZMK_KEYBOARD_NAME
	default "Charybdis dongle"

config ZMK_SPLIT_BLE_ROLE_CENTRAL
	default y

endif

if SHILED_CHARYBDIS_DONGLE || SHIELD_CHARYBDIS_LEFT || SHIELD_CHARYBDIS_RIGHT

config ZMK_SPLIT
	default y
	
endif
```

## config/boards/shields/charybdis_dongle/Kconfig.shield
```kconfig
config SHIELD_CHARYBDIS_DONGLE
  def_bool $(shields_list_contains,charybdis_dongle)
  select ZMK_SPLIT_ROLE_CENTRAL
  select ZMK_SPLIT
  select SHIELD_CHARYBDIS


config SHIELD_CHARYBDIS_LEFT
	def_bool $(shields_list_contains,charybdis_left)
  select ZMK_SPLIT
  select SHIELD_CHARYBDIS

config SHIELD_CHARYBDIS_RIGHT
	def_bool $(shields_list_contains,charybdis_right)
  select ZMK_SPLIT
  select SHIELD_CHARYBDIS
```

## config/boards/shields/dante/Kconfig.shield
```kconfig
# Copyright (c) 2020 Ryan Cross
# SPDX-License-Identifier: MIT

config SHIELD_DANTE_LEFT
    def_bool $(shields_list_contains,dante_left)

config SHIELD_DANTE_RIGHT
    def_bool $(shields_list_contains,dante_right)
```

## config/boards/shields/lpm_view_adapter/Kconfig.shield
```kconfig
# Copyright (c) 2022 The ZMK Contributors
# SPDX-License-Identifier: MIT

config SHIELD_LPM_VIEW_ADAPTER
    def_bool $(shields_list_contains,lpm_view_adapter)
```

## config/boards/shields/nice_view_reverse/Kconfig.shield
```kconfig
# Copyright (c) 2022 The ZMK Contributors
# SPDX-License-Identifier: MIT

config SHIELD_NICE_VIEW_REVERSE
    def_bool $(shields_list_contains,nice_view_reverse)
```

## config/boards/shields/sofle-5-way/Kconfig.shield
```kconfig
# Copyright (c) 2020 Ryan Cross
# SPDX-License-Identifier: MIT

config SHIELD_SOFLE_5_WAY_LEFT
    def_bool $(shields_list_contains,sofle-5-way_left)

config SHIELD_SOFLE_5_WAY_RIGHT
    def_bool $(shields_list_contains,sofle-5-way_right)
```
